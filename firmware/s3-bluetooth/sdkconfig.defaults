## firmware/s3-bluetooth/sdkconfig.defaults
```kconfig
CONFIG_IDF_TARGET="esp32s3"

# Bluetooth
CONFIG_BT_ENABLED=y
CONFIG_BT_CONTROLLER_ONLY=y
CONFIG_BTDM_CTRL_MODE_BTDM=y
CONFIG_BTDM_CTRL_BR_EDR_MAX_ACL_CONN=5
CONFIG_BTDM_CTRL_BLE_MAX_CONN=5
CONFIG_BTDM_CTRL_BR_EDR_MAX_SYNC_CONN=0
CONFIG_BTDM_CTRL_AUTO_LATENCY=y
CONFIG_BTDM_CTRL_MODEM_SLEEP=n

# BTstack
CONFIG_BTSTACK_AUDIO=n

# Bluepad32
CONFIG_BLUEPAD32_MAX_DEVICES=4
CONFIG_BLUEPAD32_PLATFORM_CUSTOM=y

# Stack size (ESP-IDF 5.5+ needs more)
CONFIG_ESP_MAIN_TASK_STACK_SIZE=8192

# FreeRTOS stats (for 'tasks' console command)
CONFIG_FREERTOS_USE_TRACE_FACILITY=y
CONFIG_FREERTOS_USE_STATS_FORMATTING_FUNCTIONS=y
```
